## config/boards/shields/temporal_dongle/Kconfig.shield
```kconfig
config SHIELD_TEMPORAL_DONGLE
    def_bool $(shields_list_contains,temporal_dongle)
```

## config/west.yml
```yaml
manifest:
  remotes:
    - name: zmkfirmware
      url-base: https://github.com/zmkfirmware
    - name: curbol
      url-base: https://github.com/curbol
    - name: radiumemo
      url-base: https://github.com/radiumemo
  projects:
    - name: zmk
      remote: zmkfirmware
      revision: v0.2
      import: app/west.yml
    - name: temporal-zmk
      remote: radiumemo
      revision: main
  self:
    path: config
```
